## drivers/rigol/Kconfig
```kconfig
# SPDX-License-Identifier: GPL-2.0

menuconfig RIGOL_DRIVERS
	bool "Device drivers for Rigol support"
	default y
	select GPIOLIB
	help
		Probably all of them was made by reverse engineering...

if RIGOL_DRIVERS

config RIGOL_HDCODE_GPIO
	tristate "hdcode_gpio"
	default m
	depends on m
	depends on GPIOLIB
	help
		Driver that reads 'hdcode' pullup resistors connected to gpio to calculate Hardware Number.
		Based on a reverse engineering of Rigol module with the same name.
		It creates char device /dev/hdcode_gpio from where You can read one byte HW (0-255).
		Original Rigol hdcode_gpio is not writeable, but this one is, so You can do this to change HW:
		$ printf '\x8' > /dev/hdcode_gpio
		Every change is noted in kernel messages.

config RIGOL_FG_M2C_GPIO
	tristate "fg_m2c_gpio"
	default m
	depends on m
	depends on GPIOLIB
	help
		Driver that handles one gpio to turn on and off AFG.
		
		To turn on:
		$ printf '\x1' > /dev/fg_m2c_gpio
		
		To turn off:
		$ printf '\x0' > /dev/fg_m2c_gpio

endif # RIGOL_DRIVERS
```

## drivers/xilinx/xdma/Kconfig
```kconfig
# SPDX-License-Identifier: GPL-2.0

config XILINX_XDMA
    tristate "Xilinx XDMA Reference Driver"
	depends on m

choice
    prompt "Select version of Xilinx XDMA Reference Driver"
    depends on XILINX_XDMA
    default XILINX_XDMA_2019_2_51

    config XILINX_XDMA_2019_2_51
         bool "2019.2.51"

    config XILINX_XDMA_2020_1_06
         bool "2020.1.06"

endchoice
```
